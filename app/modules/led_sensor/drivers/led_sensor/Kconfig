## app/modules/led_sensor/drivers/led_sensor/Kconfig
```kconfig
config LED_SENSOR
	bool "LED sensor driver"
	default y
	depends on DT_HAS_CUSTOM_LED_SENSOR_ENABLED
	depends on SENSOR
	select GPIO
	help
	  Sensor-API driver that drives an on-board LED.
```

## app/modules/led_sensor/dts/bindings/sensor/custom,led-sensor.yaml
```yaml
description: LED driven through the sensor API

compatible: "custom,led-sensor"

properties:
  led-gpios:
    type: phandle-array
    required: true
```

## boards/my_h723zg/Kconfig.defconfig
```kconfig
# STM32H723ZG Nucleo board configuration

# Copyright (c) 2020 Alexander Kozhinov <ak.alexander.kozhinov@gmail.com>
# SPDX-License-Identifier: Apache-2.0

if BOARD_MY_H723ZG

configdefault ETH_DRIVER
	default y

endif # BOARD_MY_H723ZG
```

## boards/scratch_h723zg/Kconfig.scratch_h723zg
```kconfig
# Copyright (c) 2020 Alexander Kozhinov <ak.alexander.kozhinov@gmail.com>
# SPDX-License-Identifier: Apache-2.0

config BOARD_SCRATCH_H723ZG
	select SOC_STM32H723XX
```

## boards/scratch_h723zg/board.yml
```yaml
board:
  name: scratch_h723zg
  full_name: Scratch H723ZG
  vendor: custom
  socs:
    - name: stm32h723xx
```
